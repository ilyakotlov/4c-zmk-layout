## config/boards/shields/4c_display_p0p2_swap/Kconfig.shield
```kconfig
config SHIELD_4C_DISPLAY_P0P2_SWAP
    def_bool $(shields_list_contains,4c_display_p0p2_swap)
```

## config/boards/shields/oled_i2c_p0p2_3d/Kconfig.shield
```kconfig
config SHIELD_OLED_I2C_P0P2_3D
    def_bool $(shields_list_contains,oled_i2c_p0p2_3d)
```

## config/boards/shields/oled_i2c_p0p2_swap_3d/Kconfig.shield
```kconfig
config SHIELD_OLED_I2C_P0P2_SWAP_3D
    def_bool $(shields_list_contains,oled_i2c_p0p2_swap_3d)
```

## config/boards/shields/oled_i2c_p0p2_swap_64/Kconfig.defconfig
```kconfig
if SHIELD_OLED_I2C_P0P2_SWAP_64

config ZMK_DISPLAY
    default y

config ZMK_DISPLAY_BLANK_ON_IDLE
    default y

config I2C
    default y

config SSD1306
    default y

endif
```

## config/boards/shields/oled_i2c_p0p2_swap_seq/Kconfig.shield
```kconfig
config SHIELD_OLED_I2C_P0P2_SWAP_SEQ
    def_bool $(shields_list_contains,oled_i2c_p0p2_swap_seq)
```
