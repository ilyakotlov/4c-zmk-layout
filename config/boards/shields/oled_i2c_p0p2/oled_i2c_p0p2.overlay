/ {
    gpioi2c: gpio_i2c {
        compatible = "gpio-i2c";
        status = "okay";
        clock-frequency = <100000>;
        sda-gpios = <&gpio0 2 GPIO_OPEN_DRAIN>;
        scl-gpios = <&gpio0 0 GPIO_OPEN_DRAIN>;
        #address-cells = <1>;
        #size-cells = <0>;

        oled: ssd1306@3c {
            compatible = "solomon,ssd1306fb";
            reg = <0x3c>;
            width = <128>;
            height = <32>;
            segment-offset = <0>;
            page-offset = <0>;
            display-offset = <0>;
            multiplex-ratio = <31>;
            segment-remap;
            com-invdir;
            com-sequential;
            inversion-on;
            prechargep = <0x22>;
            status = "okay";
        };
    };

    chosen {
        zephyr,display = &oled;
    };
};
