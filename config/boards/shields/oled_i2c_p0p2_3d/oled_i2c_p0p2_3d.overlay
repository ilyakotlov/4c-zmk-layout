/ {
    gpioi2c: gpio_i2c {
        compatible = "gpio-i2c";
        status = "okay";
        clock-frequency = <100000>;
        sda-gpios = <&pro_micro 2 (GPIO_OPEN_DRAIN | GPIO_PULL_UP)>;
        scl-gpios = <&pro_micro 0 (GPIO_OPEN_DRAIN | GPIO_PULL_UP)>;
        #address-cells = <1>;
        #size-cells = <0>;

        oled: ssd1306@3d {
            compatible = "solomon,ssd1306fb";
            reg = <0x3d>;
            width = <128>;
            height = <32>;
            segment-offset = <0>;
            page-offset = <0>;
            display-offset = <0>;
            multiplex-ratio = <31>;
            segment-remap;
            com-invdir;
            com-sequential;
            inversion-on;
            prechargep = <0x22>;
            status = "okay";
        };
    };

    chosen {
        zephyr,display = &oled;
    };
};
